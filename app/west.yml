## app/west.yml
```yaml
manifest:
  remotes:
    - name: zephyr-upstream
      url-base: https://github.com/zephyrproject-rtos

  projects:
    - name: zephyr
      remote: zephyr-upstream
      revision: v3.6.0
      import:
        # By using name-allowlist we can clone only the modules that are
        # strictly needed by the application.
        name-allowlist:
          - cmsis      # required by the ARM port
          - hal_stm32  # required by the nucleo_f302r8 board (STM32 based)
          - hal_st
          - segger

  self:
    path: app
```
